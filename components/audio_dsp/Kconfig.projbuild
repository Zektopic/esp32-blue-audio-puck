## components/audio_dsp/Kconfig.projbuild
```kconfig
menu "BlueAudio Puck: equaliser"

    config PUCK_EQ_BANDS
        int "Number of parametric bands per channel"
        default 5
        range 1 10
        help
            Each band is one biquad section per channel. Bands sitting at 0 dB
            are bypassed at runtime and cost nothing, so this sets the ceiling
            rather than a fixed price. Five is the usual tone-control layout:
            low shelf, three bells, high shelf.

    config PUCK_EQ_ENABLED_AT_BOOT
        bool "Enable the equaliser at start-up"
        default n
        help
            Off by default so the puck starts out transparent. The bands begin
            flat in any case, so turning this on changes nothing until a band
            is given some gain.

    config PUCK_EQ_BENCHMARK_AT_BOOT
        bool "Time the filter cascade at start-up"
        default n
        help
            Runs the equaliser over a synthetic block at boot and logs
            microseconds per block and the share of one core it would take with
            every band active. Costs a few milliseconds of boot time and a
            little code, so it is off by default -- turn it on when changing
            the band count, then turn it back off.

endmenu
```

## components/audio_sink/Kconfig.projbuild
```kconfig
menu "BlueAudio Puck: audio output"

    config PUCK_I2S_BCK_GPIO
        int "I2S bit clock (BCK) GPIO"
        default 26
        range 0 39
        help
            Connects to BCK on the PCM5102A breakout.

    config PUCK_I2S_LRCK_GPIO
        int "I2S word select (LRCK) GPIO"
        default 25
        range 0 39
        help
            Connects to LRCK/LCK on the PCM5102A breakout.

    config PUCK_I2S_DOUT_GPIO
        int "I2S data out (DIN) GPIO"
        default 22
        range 0 39
        help
            Connects to DIN on the PCM5102A breakout.

    choice PUCK_I2S_SLOT_FORMAT
        prompt "I2S frame format"
        default PUCK_I2S_FORMAT_PHILIPS
        help
            Must match the DAC's format pin. On a PCM5102A breakout, FMT tied to
            GND selects I2S (Philips); FMT tied high selects left-justified.

        config PUCK_I2S_FORMAT_PHILIPS
            bool "I2S (Philips) -- PCM5102A with FMT low"
        config PUCK_I2S_FORMAT_MSB
            bool "Left-justified (MSB) -- PCM5102A with FMT high"
    endchoice

    config PUCK_I2S_USE_APLL
        bool "Clock I2S from the audio PLL"
        default y
        help
            The audio PLL hits 44.1 kHz far more precisely than the default PLL
            divider does, which avoids slow sample slip on long tracks. It costs
            a small amount of extra current, so turn it off if runtime matters
            more than pitch accuracy.

    config PUCK_AUDIO_RINGBUF_KB
        int "Audio ring buffer size (kB)"
        default 32
        range 8 64
        help
            Larger buffers ride out Wi-Fi coexistence and radio retries at the
            cost of internal RAM and added latency. 32 kB is roughly 185 ms of
            stereo 16-bit 44.1 kHz audio.

    config PUCK_AUDIO_PREFETCH_PERCENT
        int "Prefetch level before playback starts (% of buffer)"
        default 25
        range 10 90
        help
            Playback waits until the buffer is this full, then runs until it is
            empty, so this is also what every underrun costs to rebuild.

            At the 32 kB default, 25% is about 46 ms -- comfortably above the
            33 ms the I2S DMA chain already holds, and above typical BR/EDR
            retry windows. The old 60% was 111 ms, which meant an audible 78 ms
            gap after every underrun and enough added latency to break lip-sync
            on video.

    config PUCK_AUDIO_WRITER_CORE
        int "CPU core for the I2S writer task"
        default 1
        range 0 1
        help
            Keep this off core 0, which runs the Bluetooth controller and stack.

endmenu
```

## components/bt_core/Kconfig.projbuild
```kconfig
menu "BlueAudio Puck: link monitoring"

    config PUCK_RSSI_POLL_SECONDS
        int "Seconds between link quality reads"
        default 3
        range 1 60
        help
            How often the puck asks the controller how the link is doing, so
            the signal meter can move.

            Bluetooth Classic does not report absolute signal strength. It
            reports a delta from the Golden Receive Power Range, so zero means
            "healthy", not "no signal". A good link reads zero and the meter
            sits full; the value only goes negative once the link is actually
            struggling. Treat the bars as fine / getting worse / about to drop
            out, not as dBm.

endmenu
```

## components/puck_avrcp/Kconfig.projbuild
```kconfig
menu "BlueAudio Puck: remote control"

    config PUCK_DEFAULT_VOLUME
        int "Volume at power-on (0-127)"
        default 96
        range 0 127
        help
            AVRCP absolute volume applied before a source connects. Most
            sources push their own value shortly after connecting, so this only
            governs the first moment of playback. 96 is about 75%.

endmenu
```

## components/puck_battery/Kconfig.projbuild
```kconfig
menu "BlueAudio Puck: battery"

    config PUCK_BATTERY_ADC_GPIO
        int "Battery sense GPIO (-1 if not fitted)"
        default -1
        range -1 39
        help
            Must be an ADC1 pin: 32-39. ADC2 is shared with the Wi-Fi radio and
            is unavailable whenever Wi-Fi is active, so it is not accepted here
            even though this firmware does not currently use Wi-Fi.

            GPIO 35 is a good choice on a devkit: input-only, so it cannot be
            driven by mistake, and it is rarely used for anything else.

            Left at -1 the firmware reports "USB powered" and never samples.

    config PUCK_BATTERY_DIVIDER_RATIO_X100
        int "Divider ratio, times 100"
        default 200
        range 100 1000
        help
            Cell voltage divided by pin voltage, times 100. Two equal resistors
            give a 2:1 divider, so 200. For other pairs the ratio is
            (R_top + R_bottom) / R_bottom.

            A full Li-po is 4.2 V and the ADC tops out near 3.1 V at 11 dB
            attenuation, so the divider must be at least about 1.4:1. 2:1 with
            two 100k resistors is the usual choice: it fits comfortably and
            draws only ~21 uA.

            Set this to match the resistors you actually fitted. A percentage
            from a wrong ratio is worse than no percentage at all.

    config PUCK_BATTERY_INTERVAL_SECONDS
        int "Seconds between samples"
        default 30
        range 1 600
        help
            Battery voltage moves slowly. Sampling often costs power and makes
            the on-screen percentage jitter with playback load.

    config PUCK_BATTERY_LOW_PERCENT
        int "Warn below this percentage"
        default 20
        range 1 90

    config PUCK_BATTERY_CRITICAL_PERCENT
        int "Treat as critical below this percentage"
        default 5
        range 1 50
        help
            At this level the firmware reports PUCK_BATTERY_CRITICAL so the UI
            can warn. It does not shut down on its own -- cutting the audio out
            from under someone is worse than running the cell a little lower.

endmenu
```

## components/puck_display/Kconfig.projbuild
```kconfig
menu "BlueAudio Puck: display"

    config PUCK_I2C_SDA_GPIO
        int "I2C SDA GPIO (-1 if no display fitted)"
        default 21
        range -1 39

    config PUCK_I2C_SCL_GPIO
        int "I2C SCL GPIO (-1 if no display fitted)"
        default 22
        range -1 39

    config PUCK_DISPLAY_I2C_ADDRESS
        hex "SSD1306 I2C address"
        default 0x3C
        range 0x08 0x77
        help
            0.96" SSD1306 modules ship strapped to either 0x3C or 0x3D
            depending on a solder jumper. 0x3C is far more common and is what
            the board this firmware was developed against answers on.

            If the panel stays dark, check the boot log: the driver probes the
            bus before configuring anything and says plainly when nothing
            acknowledges.

    config PUCK_DISPLAY_CONTRAST
        int "Contrast (0-255)"
        default 127
        range 0 255
        help
            Lower is dimmer and draws slightly less current. OLED brightness is
            not linear in this value.

    config PUCK_DISPLAY_SELF_TEST
        bool "Run the panel self test at start-up"
        default y
        help
            Fills the screen, then a checkerboard, then a border, before any
            text is drawn. None of it uses the font, which is the point: it
            separates a bus or panel fault from a text rendering fault. Costs
            about 1.4 seconds of boot time.

endmenu
```

## components/puck_power/Kconfig.projbuild
```kconfig
menu "BlueAudio Puck: power"

    config PUCK_BT_TX_POWER_LEVEL
        int "Maximum Bluetooth transmit power (0=-12dBm .. 7=+9dBm)"
        default 7
        range 0 7
        help
            Caps the radio's transmit power. 7 is +9 dBm, the most an ESP32
            will do.

            This used to default to 4 (0 dBm) on the theory that the phone is
            usually in the same pocket, so the top of the range spends current
            on range nobody is using. In practice that cost too much: 9 dB is
            about eight times the power and nearly three times the free-space
            range, and a puck in a pocket has a body between it and the phone.

            Lower it if runtime matters more than range. The controller still
            backs off on its own when the link is strong, so the cap is a
            ceiling rather than a fixed output.

    config PUCK_BT_TX_POWER_MIN_LEVEL
        int "Minimum Bluetooth transmit power (0=-12dBm .. 7=+9dBm)"
        default 4
        range 0 7
        help
            The floor Bluetooth power control may drop to when the peer is
            close. 4 is 0 dBm.

            Not -12 dBm: letting the radio fall that far leaves nothing in hand
            when someone walks away, and the current saved at the bottom of the
            range is negligible next to what the stack costs anyway.

    config PUCK_CPU_MAX_FREQ_MHZ
        int "Maximum CPU frequency (MHz)"
        default 160
        range 80 240
        help
            SBC decode plus a handful of biquads fits comfortably at 160 MHz.
            240 buys headroom for more DSP at a noticeable current cost.

    config PUCK_CPU_MIN_FREQ_MHZ
        int "Minimum CPU frequency (MHz)"
        default 80
        range 10 240
        help
            Floor the CPU drops to when nothing needs the cycles. Only has an
            effect when frequency scaling is compiled in.

    config PUCK_IDLE_SLEEP_MINUTES
        int "Deep sleep after this many idle minutes (0 disables)"
        default 15
        range 0 240
        help
            Counts only while nothing is connected. A connected but paused
            source never triggers it -- a puck that vanishes from under a
            paused phone is worse than a flat one. This does not extend
            playback at all; it is what stops the puck going flat overnight in
            a bag.

endmenu
```

## components/puck_ui/Kconfig.projbuild
```kconfig
menu "BlueAudio Puck: buttons and LED"

    comment "Buttons are active low: wire each between its pin and GND."

    config PUCK_BT1_GPIO
        int "BT1 GPIO -- next track, hold for volume up (-1 if not fitted)"
        default 32
        range -1 39
        help
            Internal pull-up, active low. No external resistor needed.

            Avoid GPIO 34-39: those pins are input-only AND have no internal
            pull-up, so a button on them floats unless you fit your own
            resistor.

    config PUCK_BT2_GPIO
        int "BT2 GPIO -- play/pause, hold to pair (-1 if not fitted)"
        default 33
        range -1 39
        help
            The main button. GPIO 33 is an RTC pin, which is why this one is
            the deep-sleep wake source: ext0 can only watch a single pin, so
            the button people reach for first gets it.

    config PUCK_BT3_GPIO
        int "BT3 GPIO -- previous track, hold for volume down (-1 if not fitted)"
        default 27
        range -1 39

    config PUCK_LED_GPIO
        int "Status LED GPIO (-1 if not fitted)"
        default -1
        range -1 33
        help
            Driven by LEDC PWM so the LED can breathe and dim rather than only
            blink. Must be an output-capable pin: GPIO 34-39 are input only.

            Defaults to "not fitted" because GPIO 2 -- the on-board LED on most
            devkits -- carries I2S data. With the OLED fitted the LED is
            largely redundant anyway, since the screen shows the same states in
            words. Note GPIO 27 is BT3 by default, so pick something else.

    config PUCK_LED_ACTIVE_LOW
        bool "Status LED is active low"
        default n
        help
            Enable if the LED is wired between the pin and 3V3 rather than
            between the pin and ground.

    config PUCK_VOLUME_STEP
        int "Volume change per repeat while a volume button is held"
        default 6
        range 1 32
        help
            In AVRCP units, where full scale is 127. Held buttons repeat every
            180 ms, so 6 sweeps the whole range in about four seconds -- fast
            enough to be useful, slow enough to stop where you meant to.

endmenu
```

## main/Kconfig.projbuild
```kconfig
menu "BlueAudio Puck: identity"

    config PUCK_BT_DEVICE_NAME
        string "Bluetooth device name"
        default "BlueAudio Puck"
        help
            Shown in the phone or computer pairing list.

    config PUCK_PAIRING_WINDOW_SECONDS
        int "How long the puck stays discoverable after a long press"
        default 120
        range 30 600
        help
            Outside this window the puck is connectable but not discoverable,
            so devices it already knows can return while strangers cannot pair.
            A puck with no bonded sources stays discoverable from boot, because
            otherwise it could never be paired at all.

endmenu
```
